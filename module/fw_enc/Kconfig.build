## module/fw_enc/Kconfig.build
```kconfig
#
# For a description of the syntax of this configuration file,
# see Documentation/kbuild/kconfig-language.txt.
#

source "build/module/fw_enc/Kconfig.common"
```

## module/fw_enc/Kconfig.common
```kconfig
config FW_ENC
        bool
        default y

config FW_REL_PATH
	string
	default "fw_enc"
	help
		Path inside fw_enc module
		Used as ${CONFIG_SYNA_SDK_PATH}/${CONFIG_FW_REL_PATH}

config FW_IMAGE_PATH
	string
	default "fw/enc"
	help
		Used as ${CONFIG_SYNA_SDK_OUT_TARGET_PATH}/${CONFIG_FW_IMAGE_PATH}
```

## module/image/Kconfig.build
```kconfig
#
# For a description of the syntax of this configuration file,
# see Documentation/kbuild/kconfig-language.txt.
#
menu "Image Generation Configuration"
config IMAGE
	bool
	default y

if IMAGE_EMMC
config EMMC_PAGE_SIZE
	int "EMMC page size"
	default 512

config EMMC_BLOCK_SIZE
	int "EMMC block size"
	default 524288

config EMMC_TOTAL_SIZE
	int "EMMC total size"
	default 7433879552

endif

if IMAGE_NAND
config NAND_CADENCE
	bool
	default y

config NAND_RANDOMIZER
	bool "enable NAND Randomization"
	default n
	help
		nand randomizer feature enable for preboot and bootloader

config NAND_PAGE_SIZE
	int "NAND page size"
	default 4096

config NAND_BLOCK_SIZE
	int "NAND block size"
	default 262144

config NAND_BOOT_PART_SIZE
	int "NAND boot part size"
	default 262144

config NAND_TOTAL_SIZE
	int "NAND total size"
	default 268435456

config NAND_ECC_STRENGTH
	int "NAND ECC strength"
	default 48

config NAND_FACTORY
	bool "NAND factory image"
	default n
endif

endmenu
```

## module/linux/Kconfig.build
```kconfig
#
# For a description of the syntax of this configuration file,
# see Documentation/kbuild/kconfig-language.txt.
#
menu "Linux Kernel"
config LINUX
	bool
	default y

if LINUX

choice
        prompt "Kernel header format"
        default HEADER_GIH
config HEADER_GIH
        bool "GIH header format"
config HEADER_KDTB
        bool "KDTB header format"
endchoice

choice
        prompt "Kernel compression method"
        default COMPRESS_LZ4
config COMPRESS_XZ
        bool "xz compression"
config COMPRESS_LZ4
        bool "lz4 compression"
endchoice

config NO_PREPEND_IMG_INFO
	bool "no prepend image info header"
	default n

config LINUX_SRC_PATH
	string "Kernel code path"
	default "linux_4_14"
	help
		Used as kernel code path

config LINUX_ARCH
	string "Arch(arm64/arm32)"
	default "arm64"

config LINUX_DEFCONFIG
	string "Defconfig name"
	default "berlin5ct_defconfig"

config LINUX_DTS
	string "DTS name"
	default "marvell/berlin5ct-stb"

config LINUX_REL_PATH
	string
	default "linux"
	help
		Used as ${CONFIG_SYNA_SDK_OUT_TARGET_PATH}/${CONFIG_LINUX_REL_PATH}

config LINUX_KASAN_ENABLE
	bool "Enable Kernel Address Sanitizer"
	default n

config LINUX_FUZZING
	bool "Additional options for kernel fuzzing"
	depends on LINUX_KASAN_ENABLE
	default n

config LINUX_DEBUG_EXTRA
	bool "Additional options for kernel bug detection"
	default n
endif
endmenu
```

## module/security/Kconfig.common
```kconfig
config SECURITY
	bool
	default y

config SECURITY_KEY_PATH
	string
	default "release/SECURITY/keys"
	help
		Used as ${CONFIG_SYNA_SDK_OUT_TARGET_PATH}/${CONFIG_SECURITY_KEY_PATH}/${syna_chip_name}/${syna_chip_rev}

config SECURITY_VERSION_PATH
	string
	default "release/SECURITY/version"
	help
		Used as ${CONFIG_SYNA_SDK_OUT_TARGET_PATH}/${CONFIG_SECURITY_VERSION_PATH}
```

## module/synap/Kconfig.common
```kconfig
config SYNAP
    bool "SYNAP"
    default n

config PRODUCTION_BUILD
	bool "Enable production build"
	default n
```

## module/sysroot/Kconfig.build
```kconfig
#
# For a description of the syntax of this configuration file,
# see Documentation/kbuild/kconfig-language.txt.
#
menu "Sysroot Filesystem Configuration"

choice
    prompt "Prebuilt sysroot"
    default RUNTIME_ANDROID if ANDROID_OS
    default RUNTIME_LINUX_BASELINE_BUILDROOT if LINUX_OS

config RUNTIME_ANDROID
	bool "Android"
config RUNTIME_LINUX_BASELINE_BUILDROOT
	bool "buildroot(arm-linux-gnueabihf-)"
config RUNTIME_LINUX_BASELINE_BUILDROOT64
	bool "buildroot(aarch64-cros-linux-gnu-)"
config RUNTIME_RDK
	bool "RDK runtime"
config RUNTIME_OE64
	bool "linux oe aarch64 sysroot"
config RUNTIME_OE
	bool "linux oe aarch32 sysroot"
endchoice

comment "Android toolchain requires android as OS"
        depends on RUNTIME_ANDROID && LINUX_OS

comment "Linux toolchain requires Linux as OS"
        depends on RUNTIME_LINUX_BASELINE_BUILDROOT && ANDROID_OS

source "build/module/sysroot/Kconfig.common"

endmenu
```

## module/sysroot/Kconfig.common
```kconfig
config SYSROOT
    bool
    default y

config RUNTIME_ANDROID_API_LEVEL
	depends on RUNTIME_ANDROID
	int "Android API level"
	default 28

config RUNTIME_FILESYSTEMS
	string "runtime filesystem format"
	default ""
	help
		For android: blank
		For EMMC linux: ramdisk(xz),system(ext4)
		For NAND linux: ramdisk(xz),rootfs(squashfs),app(yaffs2)
```

## module/ta_app/Kconfig.build
```kconfig
#
# For a description of the syntax of this configuration file,
# see Documentation/kbuild/kconfig-language.txt.
#
menu "TA_APP Configuration"

source "build/module/ta_app/Kconfig.common"

endmenu
```

## module/ta_app/Kconfig.common
```kconfig
config TA_STATIC_LIB_PATH
	string
	default "ta/lib"
	help
		Used as ${CONFIG_SYNA_SDK_OUT_TARGET_PATH}/${CONFIG_TA_STATIC_LIB_PATH}

config TA_STATIC_INC_PATH
	string
	default "ta/inc"
	help
		Used as ${CONFIG_SYNA_SDK_OUT_TARGET_PATH}/${CONFIG_TA_STATIC_INC_PATH}

config TA_BUILD_PATH
	string
	default "ta/intermediate"
	help
		Used as ${CONFIG_SYNA_SDK_OUT_TARGET_PATH}/${CONFIG_TA_BUILD_PATH}

config TA_CPPCHECK
	bool "Enable CPPCheck for TA"
	default n

config TA_CALC
	bool "Enable TA calc"
	default n

config TA_GFX_IMG
	bool "Enable GFX IMG Android GPU driver secure feature"
	default n

config TA_GFX_IMG_LINUX
	bool "Enable GFX IMG Linux Window System GPU driver secure feature"
	default n

config TA_CAF
        bool "Enable CAF TA"
        default n

config DRM_COMMON_TA
	bool "Enable drm_common_ta static lib"
	default y

config GENCRYPTO
	depends on DRM_COMMON_TA
	bool "Enable Gencrypto TA"
	default y

config TA_PVR
	depends on DRM_COMMON_TA
	bool "Enable PVR TA"
	default n

config TA_FACTORY
	depends on DRM_COMMON_TA
	bool "Enable factory TA"
	default y
```

## module/ta_enc/Kconfig.build
```kconfig
#
# For a description of the syntax of this configuration file,
# see Documentation/kbuild/kconfig-language.txt.
#

source "build/module/ta_enc/Kconfig.common"
```

## module/ta_enc/Kconfig.common
```kconfig
config TA_ENC
	bool
	default y

config TA_REL_PATH
	string
	default "ta_enc"
	help
		Path inside ta_enc module
		Used as ${CONFIG_SYNA_SDK_PATH}/${CONFIG_TA_REL_PATH}

config TA_IMAGE_PATH
	string
	default "ta/enc"
	help
		Used as ${CONFIG_SYNA_SDK_OUT_TARGET_PATH}/${CONFIG_TA_IMAGE_PATH}
```

## module/tee_dev/Kconfig.build
```kconfig
#
# For a description of the syntax of this configuration file,
# see Documentation/kbuild/kconfig-language.txt.
#

source "build/module/tee_dev/Kconfig.common"

config TEE_DEV_TEEI
        string "GPD/TZK version"
        default "GPD11_TZK520"
```

## module/tee_dev/Kconfig.common
```kconfig
config TEE_DEV
	bool
	default y

config TEE_DEV_REL_PATH
	string
	default "tee_dev"
	help
		Used as ${CONFIG_SYNA_SDK_OUT_TARGET_PATH}/${CONFIG_TEE_DEV_REL_PATH}
		There will be lib and include folder under it.
```

## module/thirdparty/Kconfig.build
```kconfig
#
# For a description of the syntax of this configuration file,
# see Documentation/kbuild/kconfig-language.txt.
#
menu "DolbyUDC build Configuration"

source "module/thirdparty/Kconfig.common"

endmenu
```

## module/thirdparty/Kconfig.common
```kconfig
config DOLBYUDC_CA
	bool "Enable DolbyUDC_CA"
	default n

config DOLBYUDC_TA
	bool "Enable DolbyUDC_TA"
	default n

config DOLBYUDC_TEST
	bool "Enable DolbyUDC_Test"
	default n

config DOLBYUDC_TAREG
	bool "Enable DolbyUDC_TAREG"
	default n
```

## module/toolchain/Kconfig.build
```kconfig
#
# For a description of the syntax of this configuration file,
# see Documentation/kbuild/kconfig-language.txt.
#
menu "Toolchain Configuration"

source "build/module/toolchain/Kconfig.common"

config LINUX_CROSS_COMPILE
	string "linux kernel cross compile prefix"
	default "aarch64-linux-gnu-"
	help
		Specify the pre-fix for differen toolchain.
		Use "llvm-clang-" for llvm/clang

config LINUX_CROSS_COMPILE_PATH
	string "linux kernel cross compile path"
	default "aarch64/gcc-arm-aarch64-linux-gnu-8.3"
	help
		Path under VSSDK/toolchain/

config LINUX_CROSS_COMPILE_CC
	string "linux kernel CC over-write option"
	default "aarch64-linux-gnu-gcc"
	help
		Change to "clang" to enable CLANG compiling for linux

config LINUX_CROSS_COMPILE_LLVM_UTILS
	depends on LINUX_CROSS_COMPILE_CC="clang"
	bool "building linux kernel with llvm utilities"
	default n
	help
		Enable LLVM=1 in Kbuild

config TOOLCHAIN_CLANG_PATH
	string "CLANG toolchain path"
        depends on LINUX_CROSS_COMPILE_CC="clang" || TOOLCHAIN_APPLICATION_CC="clang"
	default "clang/linux-x86/clang-r353983c"
	help
		Path under VSSDK/toolchain/clang

endmenu
```

## module/toolchain/Kconfig.common
```kconfig
config TOOLCHAIN
	bool
	default y

config TOOLCHAIN_PATH
	string "common toolchain path"
	default "$(TOPDIR)/build/tools/lib/ccache:$(TOPDIR)/toolchain/aarch64/gcc-arm-aarch64-elf-8.3/bin:$(TOPDIR)/toolchain/aarch64/gcc-linaro-aarch64-elf-5.3/bin:$(TOPDIR)/toolchain/aarch32/gcc-linaro-arm-eabi-6.2.1/bin:$(TOPDIR)/toolchain/aarch32/arm-none-eabi-4.9/bin:"
	help
		Internal Common Toolchain PATH for uBoot, BSP and TA

config TOOLCHAIN_TA
	string "TA toolchain prefix"
	default "arm-eabi-"
	help
		Must use C/CPP/LD flags in arm-eabi-.rc

config TOOLCHAIN_BSP
	string "bsp toolchain prefix"
	default "aarch64-elf-"
	help
		Toolchain to compile bootloader/miniloader/sysinit/u-boot

config TOOLCHAIN_APPLICATION
	string "application toolchain prefix"
	default ""
	help
		Must use C/CPP/LD flags in ${CONFIG_TOOLCHAIN_APPLICATION}.rc

config TOOLCHAIN_APPLICATION_PATH
	string "application toolchain path"
	default ""
	help
		Path under VSSDK/toolchain/

config TOOLCHAIN_APPLICATION_CC
	string "application CC over-write option"
	default ""
	help
		Change to "clang" to enable CLANG compiling for application
```

## module/uboot/Kconfig.build
```kconfig
#
# For a description of the syntax of this configuration file,
# see Documentation/kbuild/kconfig-language.txt.
#
menuconfig UBOOT
	bool "U-boot & Fastboot"
	default y
	depends on PREBOOT
	select SECURITY

if UBOOT

config UBOOT_SRC_PATH
	string "Uboot code path"
	default "u-boot_2019_10"
	help
		Used as uboot code path

if !(UBOOT_SPIUBOOT)
config UBOOT_FASTBOOT
	bool "Fastboot"
	depends on ANDROID_OS
	default y
endif

config UBOOT_SPIUBOOT
	bool "SPI U-boot"
	depends on !UBOOT_SUBOOT
	default n

config UBOOT_ARCH
	string "Architechture"
	depends on UBOOT_FASTBOOT || UBOOT_SPIUBOOT || UBOOT_SUBOOT
	default "arm"

config UBOOT_DEFCONFIG
	string "Default Config"
	depends on UBOOT_FASTBOOT || UBOOT_SPIUBOOT || UBOOT_SUBOOT
	default "berlin5ct-fastboot_defconfig"

config UBOOT_DTS
	string "DTS"
	depends on UBOOT_FASTBOOT || UBOOT_SPIUBOOT || UBOOT_SUBOOT
	default "berlin5ct-stb-fastboot"

config UBOOT_REL_PATH
	string
	depends on UBOOT_FASTBOOT || UBOOT_SPIUBOOT || UBOOT_SUBOOT
	default "release/uboot"
	help
		Used as ${CONFIG_SYNA_SDK_OUT_TARGET_PATH}/${CONFIG_UBOOT_REL_PATH}

endif
```
