## module/ampsdk/kconfig/audio/Kconfig.audio.aenc.format
```kconfig
#
# For a description of the syntax of this configuration file,
# see Documentation/kbuild/kconfig-language.txt.
#

source "module/ampsdk/kconfig/audio/Kconfig.audio.aenc.impl"

comment "Supported Formats"

config AMP_AUDIO_AACE_SUPPORTED
	bool "AACE (ZSP)"
	default y
	select AMP_AUDIO_AACE_USE_ZSP

config AMP_IP_AUDIO_DDCE_SUPPORTED
	bool "DDCE (ZSP)"
	default y
	select AMP_IP_AUDIO_DDCE_USE_ZSP

config AMP_IP_AUDIO_DTSE_SUPPORTED
	bool "DTSE (ZSP)"
	default y
	select AMP_IP_AUDIO_DTSE_USE_ZSP
```

## module/ampsdk/kconfig/audio/Kconfig.audio.aenc.impl
```kconfig
#
# For a description of the syntax of this configuration file,
# see Documentation/kbuild/kconfig-language.txt.
#

config AMP_AUDIO_AACE_USE_ARM
	bool

config AMP_AUDIO_AACE_USE_ZSP
	bool

config AMP_IP_AUDIO_DDCE_USE_ARM
	bool

config AMP_IP_AUDIO_DDCE_USE_ZSP
	bool

config AMP_IP_AUDIO_DTSE_USE_ARM
	bool

config AMP_IP_AUDIO_DTSE_USE_ZSP
	bool
```

## module/ampsdk/kconfig/audio/Kconfig.audio.aout
```kconfig
#
# For a description of the syntax of this configuration file,
# see Documentation/kbuild/kconfig-language.txt.
#

menuconfig AMP_COMPONENT_AOUT_ENABLE
	bool "Audio Output"
	default y

if AMP_COMPONENT_AOUT_ENABLE

comment "General"

config AMP_AUDIO_MUTE_PT_FOR_STREAM
	bool "Pass-Through Mute Support"
	default y

config AMP_AUDIO_SPDIF_DDP_PACK_ENABLE
	bool
	prompt "SPDIF DDP Pack Enable (DEV)" if AMP_DEVELOPMENT_OPTION
	default n

config AMP_AUDIO_I2S0_HALF_MCLK
	bool
	prompt "I2S0 HALF MCLK (DEV)" if AMP_DEVELOPMENT_OPTION
	default n

config AMP_AUDIO_ENABLE_AOUT_SNOOP
	bool
	prompt "Enable AOUT Snoop (DEV)" if AMP_DEVELOPMENT_OPTION
	default n

config AMP_AUDIO_INTERNAL_ADAC_DISABLE
	bool
	prompt "Internal ADAC Disable (DEV)" if AMP_DEVELOPMENT_OPTION
	default y

config AMP_AUDIO_ANALOG_MUTE_GPIO
	bool
	prompt "Analog Mute GPIO Support (DEV)" if AMP_DEVELOPMENT_OPTION
	default n

config AMP_GPIO_ENABLE
	depends on AMP_AUDIO_ANALOG_MUTE_GPIO
	int "Mute GPIO Number"
	default 9


comment "Pass-Through Formats"

config AMP_AUDIO_DOLBY_PT_SUPPORTED
	bool "Dolby"
	default y

if AMP_AUDIO_DOLBY_PT_SUPPORTED
source "module/ampsdk/kconfig/select_${AMP_KCONFIG_MODE}/Kconfig.audio.aout.dolbypt.select"
endif

config AMP_IP_AUDIO_DTS_PT_SUPPORTED
	bool "DTS"
	default y

if AMP_IP_AUDIO_DTS_PT_SUPPORTED
source "module/ampsdk/kconfig/select_${AMP_KCONFIG_MODE}/Kconfig.audio.aout.dtspt.select"
endif

config AMP_AUDIO_IEC61937_PT
	bool "IEC61937"
	default y

config AMP_AUDIO_MAT_PT_SUPPORTED
	bool "MAT"
	default y

config AMP_AUDIO_AAC_PT_AAC
	bool

config AMP_AUDIO_AAC_PT_SUPPORTED
	bool
	prompt "AAC (DEV)" if AMP_DEVELOPMENT_OPTION
	default n
	select AMP_AUDIO_AAC_PT_AAC

endif
```

## module/ampsdk/kconfig/audio/Kconfig.audio.aout.dolbypt.format
```kconfig
config AMP_AUDIO_DOLBY_PT_DD
	bool "DD"

config AMP_AUDIO_DOLBY_PT_DDP
	bool "DDP"

config AMP_AUDIO_DOLBY_PT_DCV
	bool "DCV"
```

## module/ampsdk/kconfig/audio/Kconfig.audio.aout.dtspt.format
```kconfig
config AMP_IP_AUDIO_DTS_PT_DTS
	bool "DTS"

config AMP_IP_AUDIO_DTS_PT_DTSHD
	bool "DTSHD"

config AMP_IP_AUDIO_DTS_PT_DTSMA
	bool "DTSMA"
```

## module/ampsdk/kconfig/audio/Kconfig.audio.app.impl
```kconfig
#
# For a description of the syntax of this configuration file,
# see Documentation/kbuild/kconfig-language.txt.
#

config AMP_AUDIO_MIXER_USE_ARM
	bool

config AMP_AUDIO_MIXER_USE_ZSP
	bool

config AMP_IP_AUDIO_NEURAL_USE_ARM
	bool

config AMP_IP_AUDIO_NEURAL_USE_ZSP
	bool

config AMP_AUDIO_SRC_USE_ARM
	bool

config AMP_AUDIO_SRC_USE_ZSP
	bool

config AMP_IP_AUDIO_SRS_USE_ARM
	bool

config AMP_IP_AUDIO_SRS_USE_ZSP
	bool

config AMP_AUDIO_TS_USE_ARM
	bool

config AMP_AUDIO_TS_USE_ZSP
	bool
```

## module/ampsdk/kconfig/audio/Kconfig.audio.app.type
```kconfig
#
# For a description of the syntax of this configuration file,
# see Documentation/kbuild/kconfig-language.txt.
#

source "module/ampsdk/kconfig/audio/Kconfig.audio.app.impl"

comment "Supported Types"

config AMP_AUDIO_MIXER_SUPPORTED
	bool "Mixer"
	default n
	select AMP_AUDIO_MIXER_USE_ARM

config AMP_AUDIO_SRC_SUPPORTED
	bool "SRC"
	default y
	select AMP_AUDIO_SRC_USE_ARM

config AMP_IP_AUDIO_NEURAL_SUPPORTED
	bool "Neural"
	default n
	select AMP_IP_AUDIO_NEURAL_USE_ZSP

menuconfig AMP_IP_AUDIO_SRS_SUPPORTED
	bool "SRS"
	default n
	select AMP_IP_AUDIO_SRS_USE_ZSP

if AMP_IP_AUDIO_SRS_SUPPORTED

config AMP_IP_AUDIO_SRS_ENABLE_CS
	bool "CS"
	default n

config AMP_IP_AUDIO_SRS_ENABLE_GEQ
	bool "GEQ"
	default n

config AMP_IP_AUDIO_SRS_ENABLE_HDLIM
	bool "HDLIM"
	default n

config AMP_IP_AUDIO_SRS_ENABLE_HPF
	bool "HPF"
	default n

config AMP_IP_AUDIO_SRS_ENABLE_TRUDIAL
	bool "TRUDIAL"
	default n

config AMP_IP_AUDIO_SRS_ENABLE_TRUEQ
	bool "TRUEQ"
	default n

config AMP_IP_AUDIO_SRS_ENABLE_TRUSURROUND
	bool "TRUSURROUND"
	default n

config AMP_IP_AUDIO_SRS_ENABLE_TRUVOLUME
	bool "TRUVOLUME"
	default y

endif

config AMP_AUDIO_TS_SUPPORTED
	bool "Time Stretch"
	default n
	select AMP_AUDIO_TS_USE_ARM
```

## module/ampsdk/kconfig/audio/Kconfig.audio.ctrl
```kconfig
#
# For a description of the syntax of this configuration file,
# see Documentation/kbuild/kconfig-language.txt.
#

menu "MS12 Solution"

config AMP_IP_AUDIO_MS12_SUPPORTED
	bool "MS12"
	default n
	select AMP_IP_AUDIO_MS12_USE_HIFI if AMP_AUDIO_USE_DSP_HIFI
	select AMP_IP_AUDIO_MS12_USE_ARM if (AMP_AUDIO_USE_ARM_ONLY || AMP_AUDIO_RELEASE)

config AMP_IP_AUDIO_MS12_USE_HIFI
	bool
config AMP_IP_AUDIO_MS12_USE_ARM
	bool

if AMP_IP_AUDIO_MS12_USE_HIFI
menuconfig AMP_IP_AUDIO_MS12_HIFI_V1_3
	bool "MS12 v1.3"
	default n

if AMP_IP_AUDIO_MS12_HIFI_V1_3
config AMP_IP_AUDIO_MS12_HIFI_V1_3_B
	bool "MS12 v1.3 config B"
	default n
config AMP_IP_AUDIO_MS12_HIFI_V1_3_D
	bool "MS12 v1.3 config D"
	default n
endif

menuconfig AMP_IP_AUDIO_MS12_HIFI_V2_6
	bool "MS12 v2.6"
	default y

if AMP_IP_AUDIO_MS12_HIFI_V2_6
config AMP_IP_AUDIO_MS12_HIFI_V2_6_X
	bool "MS12 v2.6 config X"
	default y
config AMP_IP_AUDIO_MS12_HIFI_V2_6_Y
	bool "MS12 v2.6 config Y"
	default n
config AMP_IP_AUDIO_MS12_HIFI_V2_6_Z
	bool "MS12 v2.6 config Z"
	default n
endif

endif

if AMP_IP_AUDIO_MS12_USE_ARM
menuconfig AMP_IP_AUDIO_MS12_ARM_V1_3
	bool "MS12 v1.3"
	default n

if AMP_IP_AUDIO_MS12_ARM_V1_3
config AMP_IP_AUDIO_MS12_ARM_V1_3_B
	bool "MS12 v1.3 config B"
	default n
config AMP_IP_AUDIO_MS12_ARM_V1_3_D
	bool "MS12 v1.3 config D"
	default n
endif

menuconfig AMP_IP_AUDIO_MS12_ARM_V2_4
	bool "MS12 v2.4"
	default y

if AMP_IP_AUDIO_MS12_ARM_V2_4
config AMP_IP_AUDIO_MS12_ARM_V2_4_Y_LITE
	bool "MS12 v2.4 config Y LITE"
	default n
config AMP_IP_AUDIO_MS12_ARM_V2_4_Y
	bool "MS12 v2.4 config Y"
	default n
config AMP_IP_AUDIO_MS12_ARM_V2_4_Z
	bool "MS12 v2.4 config Z"
	default y
endif

endif

endmenu
```

## module/ampsdk/kconfig/audio/Kconfig.audio.general
```kconfig
#
# For a description of the syntax of this configuration file,
# see Documentation/kbuild/kconfig-language.txt.
#

menu "General"

config AMP_AUDIO_HW_GEN
	int "audio hw processor"
	default 0
	help
		zsp: 1, hifi4: 2, no dsp: 0, all: 10(for release script)

config AMP_AUDIO_RELEASE
	bool
	default y if (AMP_AUDIO_HW_GEN = 10)

config AMP_AUDIO_USE_ZSP
	bool "ZSP"
	default y
	depends on (AMP_AUDIO_HW_GEN = 1)

config AMP_AUDIO_USE_DSP_HIFI
	bool "HIFI"
	default y
	depends on (AMP_AUDIO_HW_GEN = 2 || AMP_AUDIO_RELEASE)

config AMP_AUDIO_USE_ARM
	bool "ARM"
	default y

config AMP_AUDIO_USE_ARM_ONLY
	bool
	default y if (!AMP_AUDIO_USE_DSP_HIFI  && !AMP_AUDIO_USE_ZSP && AMP_AUDIO_USE_ARM)

config GEN_AMP_AUDIO_ENABLE_ZSP
	depends on AMP_AUDIO_USE_ZSP
	bool
	default y

config AMP_AUDIO_ZSP_SECURE_ENABLE
	depends on GEN_AMP_AUDIO_ENABLE_ZSP && AMP_TEE_ENABLE
	bool
	prompt "ZSP Secure Enable (DEV)" if AMP_DEVELOPMENT_OPTION
	default y

config AMP_COMPONENT_AREN_ENABLE
	bool
	prompt "AREN Enable (DEV)" if AMP_DEVELOPMENT_OPTION
	default y

config AMP_AUDIO_DISABLE_NEON
	bool "Disable NEON"
	default n

endmenu
```

## module/ampsdk/kconfig/audio/Kconfig.audio.service
```kconfig
#
# For a description of the syntax of this configuration file,
# see Documentation/kbuild/kconfig-language.txt.
#

menuconfig AMP_COMPONENT_SNDSRV_ENABLE
	bool "Audio Service"
	default y

if AMP_COMPONENT_SNDSRV_ENABLE

comment "General"

config AMP_AUDIO_SHARE_AENC
	bool
	prompt "Share AENC (DEV)" if AMP_DEVELOPMENT_OPTION
	default n

config AMP_AUDIO_DISABLE_71MIXER
	bool
	prompt "7.1 Mixer Disable (DEV)" if AMP_DEVELOPMENT_OPTION
	default y

config AMP_AUDIO_DISABLE_71SRC
	bool
	prompt "7.1 SRC Disable (DEV)" if AMP_DEVELOPMENT_OPTION
	default y

config AMP_AUDIO_DISABLE_BTSRC
	bool "BT SRC Disable"
	default n

config AMP_AUDIO_DISABLE_LBSRC
	bool "loopback SRC Disable"
	default n

config AMP_AUDIO_DISABLE_MAINMIXER
	bool
	prompt "Main Mixer Disable (DEV)" if AMP_DEVELOPMENT_OPTION
	default y

config AMP_AUDIO_DISABLE_MAINSRC
	bool
	prompt "Main SRC Disable (DEV)" if AMP_DEVELOPMENT_OPTION
	default n

config AMP_AUDIO_BT_OUTCTRL
	bool
	prompt "BT OUTCTRL Enable (DEV)" if AMP_DEVELOPMENT_OPTION
	default n

config AMP_AUDIO_ENABLE_BT_TUNNEL
	bool "BT Tunnel Enable"
	default n

config AMP_AUDIO_DISABLE_SNDEXP
	bool
	prompt "SNDEXP Disable (DEV)" if AMP_DEVELOPMENT_OPTION
	default n


comment "Output Paths"

config AMP_AUDIO_SNDSRV_PATH_20_DISABLE
	bool "2.0 Path Disable"
	default y

config AMP_AUDIO_SNDSRV_PATH_71_DISABLE
	bool "7.1 Path Disable"
	default n

config AMP_AUDIO_SNDSRV_PATH_HDMI_DISABLE
	bool "HDMI Path Disable"
	default n

config AMP_AUDIO_SNDSRV_PATH_SPDIF_DISABLE
	bool "SPDIF Path Disable"
	default n

config AMP_AUDIO_SNDSRV_PATH_I2S_SPEAKER_REF
	bool "FFV Ref Path Enable"
	default n

config AMP_AUDIO_SNDSRV_PATH_HDMI_RELEASE_GOOGLE
	bool
	prompt "HDMI Path Release GOOGLE (DEV)" if AMP_DEVELOPMENT_OPTION
	default n

endif
```

## module/ampsdk/kconfig/select_build/Kconfig.audio.aout.dolbypt.select
```kconfig
choice
    prompt "Format"
    default AMP_AUDIO_DOLBY_PT_DCV
source "module/ampsdk/kconfig/audio/Kconfig.audio.aout.dolbypt.format"
endchoice
```

## module/ampsdk/kconfig/select_build/Kconfig.audio.aout.dtspt.select
```kconfig
choice
    prompt "Format"
    default AMP_IP_AUDIO_DTS_PT_DTS
source "module/ampsdk/kconfig/audio/Kconfig.audio.aout.dtspt.format"
endchoice
```

## module/ampsdk/kconfig/select_build/Kconfig.drm.widevine.select
```kconfig
choice
    prompt "Select"
    default AMP_IP_DRM_WV_13
source "module/ampsdk/kconfig/Kconfig.drm.widevine.version"
endchoice
```

## module/application/Kconfig.build
```kconfig
#
# For a description of the syntax of this configuration file,
# see Documentation/kbuild/kconfig-language.txt.
#
menu "Application Configuration"

source "build/module/application/Kconfig.common"

endmenu
```

## module/bootastic/Kconfig.build
```kconfig
#
# For a description of the syntax of this configuration file,
# see Documentation/kbuild/kconfig-language.txt.
#
menu "Bootastic Configuration"

config BOOTASTIC
        bool "Bootastic for DVF101/DVF99"
        default n
endmenu
```
