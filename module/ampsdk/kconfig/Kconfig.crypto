## module/ampsdk/kconfig/Kconfig.crypto
```kconfig
menu "Cryption/Decryption"

config HW_CRYPTO_ENABLE
    bool "Synaptics HW Crypto Enable"
    default y

endmenu
```

## module/ampsdk/kconfig/Kconfig.dmx
```kconfig
menu "Demux"

config AMP_COMPONENT_DATA_EXPORTER_ENABLE
    bool "Data Exporter Enable"
    default y

config AMP_COMPONENT_DMX_ENABLE
    bool "Dmx Enable"
    default y

config AMP_COMPONENT_DMX_DSS_ENABLE
    bool "support DirecTV legacy DSS input"
    depends on AMP_COMPONENT_DMX_ENABLE
    default y

config AMP_COMPONENT_DMX_WMDEC_FILTER_ENABLE
    bool "support legacy ES filter"
    depends on AMP_COMPONENT_DMX_ENABLE
    default y

config AMP_TSP_NORMAL_CLK
    bool "set TSP as normal clock"
    default y

#config AMP_COMPONENT_FE_ENABLE
#    bool "FE Enable"
#    default n

endmenu
```

## module/ampsdk/kconfig/Kconfig.fe
```kconfig
menu "FrontEnd Driver"

config ENABLE_TUNER_DEMOD
    bool "FE Support"
    default n

if ENABLE_TUNER_DEMOD
choice
	prompt "Tuner/Demod model selection"
	default TUNER_DEMOD_CXD2856

config TUNER_DEMOD_CXD2856
	bool "Sony CXD2856 for Synaptics reference board"

config TUNER_DEMOD_CXD682X
	bool "Sony CXD682X for customer board"
endchoice
endif

endmenu
```

## module/ampsdk/kconfig/audio/Kconfig.audio.adec.format
```kconfig
#
# For a description of the syntax of this configuration file,
# see Documentation/kbuild/kconfig-language.txt.
#

source "module/ampsdk/kconfig/audio/Kconfig.audio.adec.impl"

comment "Supported Formats"

config AMP_AUDIO_AAC_SUPPORTED
	bool "AAC"
	default y
	select AMP_AUDIO_AAC_USE_ARM if AMP_AUDIO_USE_ARM
	#select AMP_AUDIO_AAC_USE_ARM if (AMP_AUDIO_USE_ARM_ONLY || AMP_AUDIO_RELEASE)
	#select AMP_AUDIO_AAC_USE_HIFI if AMP_AUDIO_USE_DSP_HIFI

config AMP_AUDIO_ADPCM_SUPPORTED
	bool "ADPCM"
	default y
	depends on AMP_AUDIO_USE_ARM
	select AMP_AUDIO_ADPCM_USE_ARM

config AMP_AUDIO_AMR_SUPPORTED
	bool "AMR"
	default y
	depends on AMP_AUDIO_USE_ARM
	select AMP_AUDIO_AMR_USE_ARM

config AMP_AUDIO_FLAC_SUPPORTED
	bool "FLAC"
	default y
	select AMP_AUDIO_FLAC_USE_ARM if AMP_AUDIO_USE_ARM
	#select AMP_AUDIO_FLAC_USE_ARM if (AMP_AUDIO_USE_ARM_ONLY || AMP_AUDIO_RELEASE)
	#select AMP_AUDIO_FLAC_USE_HIFI if AMP_AUDIO_USE_DSP_HIFI

config AMP_AUDIO_G711_SUPPORTED
	bool "G711"
	default y
	depends on AMP_AUDIO_USE_ARM
	select AMP_AUDIO_G711_USE_ARM

config AMP_AUDIO_LATM_SUPPORTED
	bool "LATM"
	default y
	depends on AMP_AUDIO_USE_ARM
	select AMP_AUDIO_LATM_USE_ARM

config AMP_AUDIO_LPCM_SUPPORTED
	bool "LPCM"
	default y
	depends on AMP_AUDIO_USE_ARM
	select AMP_AUDIO_LPCM_USE_ARM

config AMP_IP_AUDIO_MPEG_SUPPORTED
	bool "MP3"
	default y
	select AMP_IP_AUDIO_MPEG_USE_ARM if AMP_AUDIO_USE_ARM
	#select AMP_IP_AUDIO_MPEG_USE_ARM if (AMP_AUDIO_USE_ARM_ONLY || AMP_AUDIO_RELEASE)
	#select AMP_IP_AUDIO_MPEG_USE_HIFI if AMP_AUDIO_USE_DSP_HIFI
	select AMP_AUDIO_MP3_USE_ARM if (AMP_AUDIO_USE_ARM_ONLY || AMP_AUDIO_RELEASE)
	select AMP_AUDIO_MP3_USE_HIFI if AMP_AUDIO_USE_DSP_HIFI

config AMP_IP_AUDIO_ADECCA_SUPPORTED
	bool "ADECCA"
	default n

config AMP_AUDIO_RAWPCM_SUPPORTED
	bool "RAWPCM"
	default y
	depends on AMP_AUDIO_USE_ARM
	select AMP_AUDIO_RAWPCM_USE_ARM

config AMP_IP_AUDIO_UDC_SUPPORTED
	bool "UDC"
	default n
	depends on AMP_AUDIO_USE_ARM
	select AMP_IP_AUDIO_UDC_USE_ARM

config  AMP_IP_AUDIO_UDC_LITE_SUPPORTED
	bool "UDC LITE"
	default n
	depends on AMP_AUDIO_USE_ARM
	select AMP_IP_AUDIO_UDC_LITE_USE_ARM

config AMP_AUDIO_VORBIS_SUPPORTED
	bool "VORBIS"
	default y
	select AMP_AUDIO_VORBIS_USE_ARM if AMP_AUDIO_USE_ARM
	#select AMP_AUDIO_VORBIS_USE_ARM if (AMP_AUDIO_USE_ARM_ONLY || AMP_AUDIO_RELEASE)
	#select AMP_AUDIO_VORBIS_USE_HIFI if AMP_AUDIO_USE_DSP_HIFI

config  AMP_AUDIO_WMA_SUPPORTED
	bool "WMA"
	default n
	select AMP_AUDIO_WMA_USE_ARM if AMP_AUDIO_USE_ARM
	#select AMP_AUDIO_WMA_USE_ARM if  (AMP_AUDIO_USE_ARM_ONLY || AMP_AUDIO_RELEASE)
	#select AMP_AUDIO_WMA_USE_HIFI if AMP_AUDIO_USE_DSP_HIFI

config AMP_IP_AUDIO_DOLBYPASS_SUPPORTED
	bool
	prompt "DOLBYPASS (DEV)" if AMP_DEVELOPMENT_OPTION
	default n
	depends on AMP_AUDIO_USE_ARM
	select AMP_IP_AUDIO_DOLBYPASS_USE_ARM

config AMP_AUDIO_OPUS_SUPPORTED
	bool "OPUS"
	default n
	select AMP_AUDIO_OPUS_USE_HIFI if AMP_AUDIO_USE_DSP_HIFI

menu "Format Options"

config AMP_AUDIO_MAX_CH_AAC
	depends on AMP_AUDIO_AAC_SUPPORTED
	int "AAC MAX Channel Num"
	default 8

config AMP_AUDIO_MAX_CH_DOLBY
	depends on AMP_IP_AUDIO_DDP_SUPPORTED
	int "DOLBY MAX Channel Num"
	default 6

config AMP_IP_AUDIO_MAX_CH_DTS
	depends on AMP_IP_AUDIO_DTS_SUPPORTED
	int "DTS MAX Channel Num"
	default 6

config AMP_IP_AUDIO_MAX_CH_WMA
	depends on AMP_AUDIO_WMA_SUPPORTED
	int "WMA MAX Channel Num"
	default 8

config AMP_IP_AUDIO_AC3ONLY
	depends on AMP_IP_AUDIO_DDP_SUPPORTED
	bool "AC3 Only"
	default n

config AMP_AUDIO_ENABLE_FILTER_FOR_RAWPCM
	depends on AMP_AUDIO_RAWPCM_SUPPORTED
	bool
	prompt "RAWPCM Filter Enable (DEV)" if AMP_DEVELOPMENT_OPTION
	default n

config AMP_AUDIO_UDC_CERF_ENABLE
	depends on AMP_IP_AUDIO_UDC_SUPPORTED || AMP_IP_AUDIO_UDC_LITE_SUPPORTED
	bool
	prompt "UDC Certification Enable (DEV)" if AMP_DEVELOPMENT_OPTION
	default n

endmenu
```

## module/ampsdk/kconfig/audio/Kconfig.audio.adec.impl
```kconfig
#
# For a description of the syntax of this configuration file,
# see Documentation/kbuild/kconfig-language.txt.
#

#AAC
config AMP_AUDIO_AAC_USE_ARM
	bool
config AMP_AUDIO_AAC_USE_HIFI
	bool

#ADPCM
config AMP_AUDIO_ADPCM_USE_ARM
	bool

#AMR
config AMP_AUDIO_AMR_USE_ARM
	bool

#DDP
config AMP_IP_AUDIO_DDP_USE_ARM
	bool

#DolbyBypass
config AMP_IP_AUDIO_DOLBYPASS_USE_ARM
	bool

#DTS
config AMP_IP_AUDIO_DTS_CORE_USE_ARM
	bool

config AMP_IP_AUDIO_DTS_DUMMY_USE_ARM
	bool

config AMP_IP_AUDIO_DTS_HD_USE_ARM
	bool

config AMP_IP_AUDIO_DTS_MA_USE_ARM
	bool

#FLAC
config AMP_AUDIO_FLAC_USE_ARM
	bool
config AMP_AUDIO_FLAC_USE_HIFI
	bool

#G711
config AMP_AUDIO_G711_USE_ARM
	bool

#LATM
config AMP_AUDIO_LATM_USE_ARM
	bool

#LPCM
config AMP_AUDIO_LPCM_USE_ARM
	bool

#MPEG
config AMP_IP_AUDIO_MPEG_USE_ARM
	bool
config AMP_IP_AUDIO_MPEG_USE_HIFI
	bool

#MP3
config AMP_AUDIO_MP3_USE_ARM
	bool
config AMP_AUDIO_MP3_USE_HIFI
	bool

#RawPCM
config AMP_AUDIO_RAWPCM_USE_ARM
	bool

#UDC/UDC Lite
config AMP_IP_AUDIO_UDC_USE_ARM
	bool
config AMP_IP_AUDIO_UDC_LITE_USE_ARM
	bool

#Vorbis
config AMP_AUDIO_VORBIS_USE_ARM
	bool
config AMP_AUDIO_VORBIS_USE_HIFI
	bool

#WMA
config AMP_AUDIO_WMA_USE_ARM
	bool
config AMP_AUDIO_WMA_USE_HIFI
	bool

## DSP HiFi implementation Only
#
config AMP_AUDIO_OPUS_USE_HIFI
	bool
```

## module/ampsdk/kconfig/audio/Kconfig.audio.ms12
```kconfig
#
# For a description of the syntax of this configuration file,
# see Documentation/kbuild/kconfig-language.txt.
#

menu "MS12 Solution"

config AMP_IP_AUDIO_MS12_SUPPORTED
	bool "MS12"
	default n
	select AMP_IP_AUDIO_MS12_USE_HIFI if AMP_AUDIO_USE_DSP_HIFI
	select AMP_IP_AUDIO_MS12_USE_ARM if (AMP_AUDIO_USE_ARM_ONLY || AMP_AUDIO_RELEASE)

config AMP_IP_AUDIO_MS12_USE_HIFI
	bool
config AMP_IP_AUDIO_MS12_USE_ARM
	bool

if AMP_IP_AUDIO_MS12_USE_HIFI

menuconfig AMP_IP_AUDIO_MS12_HIFI_V2_6
	bool "MS12 v2.6"
	default y

if AMP_IP_AUDIO_MS12_HIFI_V2_6
config AMP_IP_AUDIO_MS12_HIFI_V2_6_X
	bool "MS12 v2.6 config X"
	default y
config AMP_IP_AUDIO_MS12_HIFI_V2_6_Y
	bool "MS12 v2.6 config Y"
	default n
config AMP_IP_AUDIO_MS12_HIFI_V2_6_Z
	bool "MS12 v2.6 config Z"
	default n
endif

endif

if AMP_IP_AUDIO_MS12_USE_ARM

choice
	prompt "MS12 Version"
	default AMP_IP_AUDIO_MS12_ARM_V2_4

config AMP_IP_AUDIO_MS12_ARM_V2_4
	bool "MS12v2.4"

config AMP_IP_AUDIO_MS12_ARM_V2_8_1
	bool "MS12v2.8.1"
endchoice

if AMP_IP_AUDIO_MS12_ARM_V2_4
choice
	prompt "Configuration"
	default AMP_IP_AUDIO_MS12_ARM_V2_4_Z

config AMP_IP_AUDIO_MS12_ARM_V2_4_Y_LITE
	bool "MS12 v2.4 config Y LITE"

config AMP_IP_AUDIO_MS12_ARM_V2_4_Y
	bool "MS12 v2.4 config Y"

config AMP_IP_AUDIO_MS12_ARM_V2_4_Z
	bool "MS12 v2.4 config Z"
endchoice
endif

if AMP_IP_AUDIO_MS12_ARM_V2_8_1
choice AMP_IP_AUDIO_MS12_ARM_V2_8_1_Y
	prompt "Configuration"
	default AMP_IP_AUDIO_MS12_ARM_V2_8_1_Y

config AMP_IP_AUDIO_MS12_ARM_V2_8_1_Y
	bool "MS12 v2.8.1 config Y"
endchoice
endif

config MS12_VERSION
	string
	default "V2_4" if AMP_IP_AUDIO_MS12_ARM_V2_4
	default "V2_8_1" if AMP_IP_AUDIO_MS12_ARM_V2_8_1

endif

endmenu
```

## module/application/Kconfig.common
```kconfig
config POWERMANAGED
	depends on LINUX_OS
	bool "enable power managerment"
	default n

config APP_GPIO
	depends on AMPSDK
	bool "GPIO control appilcation"
	default n
	help
		Control SoC and SM GPIO

config APP_SMBOX
	depends on AMPSDK
	bool "System Manger control appilcation"
	default n
	help
		Control SM

config TEST_STANDBY
        depends on AMPSDK
        bool "Standby mode tester"
        default n
        help
                Pure SDK standby mode test

config TEST_SPI
	bool "SPI tester"
	default n

config WATCHDOGD
	depends on AMPSDK
	bool "Watchdog daemon utility"
	default n

config VOICECAPTURE
	bool "Voice capture with ALSA"
	default n

config LIBSYNAV4L2
	depends on AMPSDK
	bool "syna v4l2 lib"
	default n

config V4L2TEST
	depends on LIBSYNAV4L2
	bool "syna v4l2 layer sample test"
	default n

config V4L2_CODEC
    bool "v4l2 vcodec driver test"
    default n

config ISP_PQTOOL
	depends on AMP_COMPONENT_ISP_ENABLE
	bool "ISP PQ tool Server"
	default n

config OTA_API
	bool "Over to Air"
	default n

config TEST_OTA
	bool "Over to Air Tester"
	default n

config VOIPSDK_VS6X0
	bool "VoIPSDK VS6x0 stack/applications"
	default n

config DEMOS
	bool "VideoSDK stack/applications"
	default n

config VOIPSDK_DVFXX
	bool "VoIPSDK DVF101/DVF99 stack/applications"
	default n

config GSTREAMER_PLUGINS_SYNA
	bool "GStreamer Synaptics Plugins"
	default n

config BOOTCTRL
        bool "Synaptics bootctrl tool"
        default n

config POWER
        bool "Synaptics Power measure tool"
        default n

config SYNA_COMPOSITOR
	bool "Synaptics syna-compositor"
	default n

config V4L2ISP
	bool "v4l2isp driver tframeworks mediacontrol"
	default n
```
