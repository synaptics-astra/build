## Kconfig.build
```kconfig
#
# For a description of the syntax of this configuration file,
# see Documentation/kbuild/kconfig-language.txt.
#
mainmenu "VSSDK BUILD Configuration"

menu "Build Configuration"
source "Kconfig.product"
endmenu

menu "Target Options"

source "kconfig/Kconfig.chip"

choice
	prompt "Target OS"
	default ANDROID_OS

source "kconfig/Kconfig.os"
endchoice

config JTAG_ENABLE
	bool "Enable JTAG"
		default n
		help
			enable JTAG

source "module/sysroot/Kconfig.build"
choice
	prompt "Image Type"
	default IMAGE_EMMC
config IMAGE_EMMC
	bool "EMMC image"
config IMAGE_NAND
	bool "NAND image"
config IMAGE_USBBOOT
	bool "USBBOOT image"
endchoice

source "kconfig/Kconfig.bootflow"

source "module/image/Kconfig.build"

endmenu

menu "Host Options"

config CPU_NUMBER
	int "CPU for compiling"
	default 18

source "kconfig/Kconfig.path"
config SYNA_SDK_OUT_SYSYROOT
	string
	default "build_sysroot"
	help
		System root for build.
		Used as ${CONFIG_SYNA_SDK_OUT_TARGET_PATH}/${CONFIG_SYNA_SDK_OUT_SYSYROOT}

config SYNA_SDK_OUT_ROOTFS
	string
	default "system"
	help
		Root FS for image generation
		Used as ${CONFIG_SYNA_SDK_OUT_TARGET_PATH}/${CONFIG_SYNA_SDK_OUT_ROOTFS}


source "module/toolchain/Kconfig.build"
source "kconfig/Kconfig.tool"
endmenu


source "module/linux/Kconfig.build"

menu "Boot"

config PREBOOT_PLATFORM
	string "platform for boot"
	default "bg5ct_stb"
	help
		bg5ct_stb/bg5ct_minibox/bg5ct_sec/bg5ct_pek/bg5ct_ffv/bg5ct_IP1500/bg5ct_ginkgo/bg5ct_mozart

config GENX_ENABLE
	bool "GenX enable"
		default n
		help
			enable GenX secure boot flow

config FASTBOOT_FLOW
	bool "enable fastboot in bootflow"
	depends on ANDROID_OS
	default y

choice
	prompt "PREBOOT type"
	default PREBOOT
config PREBOOT
	bool "standard preboot"
endchoice

source "module/preboot/Kconfig.build"

choice
        prompt "BOOTLOADER type"
	default BOOTLOADER
config BOOTLOADER
        bool "standard bootloader"
config UBOOT_SUBOOT
        bool "U-Boot as bootloader"
endchoice

source "module/bootloader/Kconfig.build"

source "module/uboot/Kconfig.build"
endmenu

menu "Trusted Environment Options"

source "module/tee/Kconfig.build"
source "module/tee_dev/Kconfig.build"
endmenu

source "module/drm/Kconfig.build"

source "module/ampsdk/Kconfig.build"
source "module/ta_enc/Kconfig.build"
source "module/fw_enc/Kconfig.build"
source "module/drivers/Kconfig.build"

menu "SYNAP Configuration"
source "module/synap/Kconfig.build"
source "module/synap_tools/Kconfig.build"
endmenu

menu "Target Packages"
source "module/application/Kconfig.build"
source "module/external/Kconfig.build"
source "module/ta_app/Kconfig.build"
endmenu

source "module/security/Kconfig.build"
```

## Kconfig.feature.soc
```kconfig
#
# For a description of the syntax of this configuration file,
# see Documentation/kbuild/kconfig-language.txt.
#
mainmenu "VSSDK SOC Release Configuration"

menu "Target Options"

config BERLIN_LIST_SOC_VERSION
	string "SoC version supported"
	default "Z1 A0"

config BERLIN_LIST_RUNTIME_OS
	string "Runtime OS supported"
	default "ANDROID LINUX"

config BERLIN_LIST_MARKET_ID
	string "Market ID supported"
	default "0 1 3 7"

config BERLIN_LIST_CODETYPE
	string "Security CodeType supported"
	default " 5 15"

config BERLIN_LIST_FLASHTYPE
	string "FLASH supported"
	default "EMMC NAND"

config BERLIN_LIST_NAND_RANDOMIZER
	bool
	default y

config BERLIN_LIST_BL_TA
	string "Bootloader TA supported"
	default "FASTBOOT KEYMASTER"

config BERLIN_LIST_TZK_MEM_LAYOUT
	string "TZK memory layout supported"
	default "stb_1.5g stb_2g stb_2g_cma"

config BERLIN_LIST_FW_ENC
	string "FW supported"
	default "ALL"

config BERLIN_LIST_SEC_BOOT_LVL
	string "Secured boot level"
	default "normal nocs genx"

config BERLIN_LIST_NOCS_TYPE
	string "NOCS type"
	default "type_m"

config BERLIN_LIST_GENX_TYPE
	string "GENX type"
	default "generic"

config BERLIN_LIST_FASTBOOT
	string "FASTBOOT supported"
	default "y n"

config BERLIN_LIST_TEEI
	string "TEEI version"
	default "GPD11_TZK520"

endmenu
```

## Kconfig.product
```kconfig
comment "Give a Description for VSSDK Configuration"
config DESCRIPTION
    string "Description"
    default "Undefined Configuration"
    help
        Give a description of this configuration here

config PRODUCT_NAME
	string "Product Name"
	default "bg5ct_a0_android_q_launched_stb_v4"
	help
		Used as ${CONFIG_SYNA_SDK_PRODUCT_PATH}/${CONFIG_PRODUCT_NAME}

config BOARD_NAME
	string "Board Name"
	default ""
	help
                Used as ${CONFIG_BOARD_NAME}

config PRODUCT_IP_LIST
	string "Product IP CSV file(Synaptics internal use only)"
	default ""
	help
		Synaptics internal use only. Simulate customer build

config PRODUCT_IP_MAPPING_LIST
        string "Product IP mapping CSV file(Synaptics internal use only)"
        default ""
        help
                Synaptics internal use only. Simulate customer build

config RDK_SYS
	bool "RDK System"
	default n
```

## kconfig/Kconfig.bootflow
```kconfig
choice  
        prompt "bootflow"
        default PREBOOT_BOOTFLOW_NR

config PREBOOT_BOOTFLOW_NR
        bool "normal/recovery"

config PREBOOT_BOOTFLOW_AB
        bool "AB update"
endchoice
```

## kconfig/Kconfig.chip
```kconfig
choice
        prompt "Target SoC"
        default BERLIN_PLATYPUS_A0

config BERLIN_DOLPHIN_Z1
        bool "BERLIN DOLPHIN Z1"

config BERLIN_PLATYPUS_A0
        bool "BERLIN PLATYPUS A0"

config BERLIN_DOLPHIN_A0
        bool "BERLIN DOLPHIN A0"

config BERLIN_MYNA2_A0
        bool "BERLIN MYNA2 A0"

endchoice
```

## kconfig/Kconfig.path
```kconfig
config SYNA_SDK_PATH
	string
	default "$(TOPDIR)"

config SYNA_SDK_PRODUCT_PATH
	string "Product Configuration Path"
	default "$(TOPDIR)/configs/product"

config SYNA_SDK_OUT_TARGET_PATH
	string
	default "$(TOPDIR)/out/${OUT_PRODUCT_DIR}/target"

config SYNA_SDK_OUT_HOST_OBJ_PATH
	string
	default "$(TOPDIR)/out/${OUT_PRODUCT_DIR}/host/obj/EXECUTABLES"

config SYNA_SDK_OUT_HOST_REL_PATH
	string
	default "$(TOPDIR)/out/${OUT_PRODUCT_DIR}/host/bin"

config SYNA_SDK_BUILD_PATH
	string
	default "$(TOPDIR)/out/${OUT_PRODUCT_DIR}/build"

config SYNA_SDK_KEY_PATH
	string "Product Key Path"
	default "$(TOPDIR)/security/keys"

config SYNA_SDK_TA_BUILD_PATH
	string
	default "$(TOPDIR)/ta_app/build"
```

## kconfig/Kconfig.release.chip
```kconfig
config BERLIN_LIST_SOC
	string "Supported SoC"
	default "DOLPHIN PLATYPUS MYNA2"
```

## module/ampsdk/Kconfig.build
```kconfig
#
# For a description of the syntax of this configuration file,
# see Documentation/kbuild/kconfig-language.txt.
#

menuconfig AMPSDK
    bool "AMP Enable"
    default y
    help
        AMP support

if AMPSDK

source "module/ampsdk/kconfig/Kconfig.system"
source "module/ampsdk/kconfig/Kconfig.drm"
source "module/ampsdk/kconfig/Kconfig.clk"
source "module/ampsdk/kconfig/Kconfig.avin"
source "module/ampsdk/kconfig/Kconfig.dmx"
source "module/ampsdk/kconfig/Kconfig.video"
source "module/ampsdk/kconfig/Kconfig.audio"
source "module/ampsdk/kconfig/Kconfig.isp"
source "module/ampsdk/kconfig/Kconfig.fe"
source "module/ampsdk/kconfig/Kconfig.scrd"
source "module/ampsdk/kconfig/Kconfig.amplitude"

endif
```

## module/ampsdk/Kconfig.build.dep
```kconfig
#
# For a description of the syntax of this configuration file,
# see Documentation/kbuild/kconfig-language.txt.
#

# amp and its dependent modules
source "module/synap/Kconfig.build"
source "module/ampsdk/Kconfig.build"

source "kconfig/Kconfig.bootflow"
source "kconfig/Kconfig.chip"
```

## module/ampsdk/Kconfig.feature.dep
```kconfig
#
# For a description of the syntax of this configuration file,
# see Documentation/kbuild/kconfig-language.txt.
#

# amp and its dependent modules
source "module/ampsdk/Kconfig.feature"

source "kconfig/Kconfig.chip"
```

## module/ampsdk/kconfig/Kconfig.amplitude
```kconfig
menu "AMPLITUDE middleware"

config AMPLITUDE
    bool "amplitude"
    default n

endmenu
```

## module/ampsdk/kconfig/Kconfig.audio
```kconfig
#
# For a description of the syntax of this configuration file,
# see Documentation/kbuild/kconfig-language.txt.
#

menu "Audio"

source "module/ampsdk/kconfig/audio/Kconfig.audio.general"
source "module/ampsdk/kconfig/audio/Kconfig.audio.ctrl"
source "module/ampsdk/kconfig/audio/Kconfig.audio.adec"
source "module/ampsdk/kconfig/audio/Kconfig.audio.aenc"
source "module/ampsdk/kconfig/audio/Kconfig.audio.app"
source "module/ampsdk/kconfig/audio/Kconfig.audio.aout"
source "module/ampsdk/kconfig/audio/Kconfig.audio.service"

endmenu
```

## module/ampsdk/kconfig/Kconfig.avin
```kconfig
config AMP_COMPONENT_AVIN_ENABLE
    bool "AVIN (Audio/Video Input) Enable"
    default n

config AMP_AVIN_ENABLE_CYPRESS
    bool
    depends on AMP_COMPONENT_AVIN_ENABLE
```

## module/ampsdk/kconfig/Kconfig.drm
```kconfig
menuconfig ENABLE_DRM
    bool "DRM SCHEME"
    select AMP_DRM_ENG_BCM
    default y

if ENABLE_DRM

config AMP_DRM_DEBUG_ENABLE
    bool "Log Enable"
    default n

config AMP_DRM_ENG_BCM
    bool
    default y

config AMP_DRM_STATIC_CURL
    bool "Static CURL"
    default y

config AMP_IP_DRM_CIP
    bool
    default n

config AMP_IP_DRM_DTCPIP
    bool
    default n

config AMP_IP_DRM_DUMMY
    bool
    default y if VSSDK_RELEASE

config AMP_IP_DRM_FIRSTBOOT
    bool
    default y

config ENABLE_NEWFIRSTBOOT
    depends on AMP_IP_DRM_FIRSTBOOT
    bool
    default y

config AMP_IP_DRM_GENERIC_CRYPTO
    bool "Generic CRYPTO"
    default y

config AMP_IP_DRM_HDCP2X
    bool
    default n

config AMP_IP_DRM_NAGRA
    depends on TOOLCHAIN_APPLICATION!="armv7a-cros-linux-gnueabihf-"
    bool "NAGRA"
    default n

config AMP_IP_DRM_NAGRA_EFPK
    depends on AMP_IP_DRM_NAGRA
    bool "NAGRA EFPK"
    default n

config AMP_IP_DRM_CISCOVSSS
    bool "CISCO VSSS"
    default n

config AMP_IP_DRM_OPENCRYPTO
    bool "Open Crypto"
    default y if VSSDK_RELEASE

config AMP_IP_DRM_PVR
    bool
    default n

config AMP_IP_DRM_STUB
    bool
    default y if VSSDK_RELEASE

config AMP_IP_DRM_VMX_ULTRA
    bool "VMX Ultra"
    default y

config AMP_IP_DRM_KEY
    bool "KEY"
    default n

config AMP_IP_DRM_PRIKLADDER
    bool
    default n

config AMP_IP_DRM_PR
    bool "Playready 2.5 Supported"
    default y if VSSDK_RELEASE

config AMP_IP_DRM_PR_25
    bool "Ver. 25"
    default y if AMP_IP_DRM_PR

config AMP_IP_DRM_WV
    bool "Widevine Supported"
    default y

if AMP_IP_DRM_WV
source "module/ampsdk/kconfig/select_${AMP_KCONFIG_MODE}/Kconfig.drm.widevine.select"
endif

config AMP_IP_DRM_NSK
    bool "NSK DRM"
    default n

if AMP_IP_DRM_NSK
config AMP_IP_DRM_NSK_HARMONIZER
    bool "NSK Harmonizer"
    default n
endif

config AMP_IP_DRM_IRDETO
    bool "IRDETO DRM"
    default n

config AMP_GENX_ENABLE
   bool "GenX Encryption Supported"
   default y if GENX_ENABLE

config AMP_ENABLE_GKL
    bool "Enable GKL TA"
    default n
endif
```

## module/ampsdk/kconfig/Kconfig.drm.widevine.version
```kconfig
config AMP_IP_DRM_WV_11
    bool "Ver. 11"

config AMP_IP_DRM_WV_13
    bool "Ver. 13"

config AMP_IP_DRM_WV_14
    bool "Ver. 14"

config AMP_IP_DRM_WV_15
    bool "Ver. 15"

config AMP_IP_DRM_WV_16
    bool "Ver. 16"

config AMP_IP_DRM_WV_17
    bool "Ver. 17"
```

## module/ampsdk/kconfig/Kconfig.isp
```kconfig
menu "Image Processing Pipeline"

config AMP_COMPONENT_ISP_ENABLE
    bool "ISP Component  Enable"
    default n

if AMP_COMPONENT_ISP_ENABLE
config AMP_ISPBE_ENABLE
    bool "ISP BACKEND Enable"
    default n

if AMP_ISPBE_ENABLE
config AMP_COMPONENT_DEWARP_ENABLE
    bool "ISP Dewarp Enable"
    default n

config AMP_COMPONENT_ROTATE_ENABLE
    bool "ISP Rotate Enable"
    default n

config AMP_COMPONENT_DNS_ENABLE
    bool "ISP Downscalar Enable"
    default n
endif
endif

endmenu
```

## module/ampsdk/kconfig/Kconfig.scrd
```kconfig
menu "Smartcard Support"
config SCRD
	bool "Smartcard driver Enable"
	default n
endmenu
```

## module/ampsdk/kconfig/Kconfig.system
```kconfig
menu "Amp System Settings"

config AMP_DEVELOPMENT_OPEN
    int "Development option"
    default 0
    help
        enable amp development option prompt.
        normally needed in bring up stage.
        internal use only.
        set value=21 open this option

config AMP_DEVELOPMENT_OPTION
    bool
    default y if AMP_DEVELOPMENT_OPEN = 21
    help
        enable amp development option prompt.

config AMP_TA_LOADABLE
    bool
    default y

config AMP_TZ_3_ENABLE
    bool
    default y

config AMP_PROFILE
    string "AMP profile name"
    default "atv_bg5ct_a0"

config AMP_OUTPUT_PATH
    string
    default "ampsdk"
    help
        Used as ${CONFIG_SYNA_SDK_OUT_TARGET_PATH}/${CONFIG_AMP_OUTPUT_PATH}

config AMP_VERSION_STRING
    string
    default "2.1"

config AMP_TEE_ENABLE
    bool "TEE Enable"
    select TEE
    select AMP_TA_LOADABLE
    select AMP_TZ_3_ENABLE
    default y

config AMP_COMPONENT_DUM_ENABLE
    bool
    prompt "DUM Enable" if AMP_DEVELOPMENT_OPTION
    default y

config AMP_ENABLE_CLKPWR_GATING
    bool
    prompt "CLKPWR Gating Enable" if AMP_DEVELOPMENT_OPTION
    default n

config AMP_CPM_ENABLE
    bool "CPM Enable"
    default y

config AMP_QOS_ENABLE
    bool "QOS Enable"
    default y

config AMP_LOW_MEMORY_ENABLE
    bool "low memory on"
    default n

config AMP_DEV_TOOLS
    bool "DEV Tool"
    select FFMPEG
    default y

config DYNAMIC_FFMPEG
    bool "Dynamic FFMPEG"
    default y

config ENABLE_ISR_AFFINITY
    bool
    prompt "ISR Affinity Enable" if AMP_DEVELOPMENT_OPTION
    default y

config AMP_RELEASE_BUILD
    bool "Release build"
    default y
    help
        Remove debug information

config AMP_SHM_STD_ION
    bool "Standard ION"
    default n
    help
        ion usage following linux mainline since 4.14

config AMP_IOMMU
    bool
    prompt "IOMMU feature"
    default n
    help
        iommu can only enabled with chip supported.

config AMP_BACKUP_PROFILE
    bool "Profile backup"
    default n

config AMP_SYS_LOW_COST
    bool "low-cost platform"
    default n

config AMP_MIPI_ENABLE
    bool "Is Handheld Product"
    default n

config AMP_MIPI_PANEL
    string "MIPI Config Params File name"
    default ""

endmenu
```

## module/ampsdk/kconfig/Kconfig.video
```kconfig
menu "Video Pipeline"

config AMP_COMPONENT_VENC_ENABLE
    bool "VENC (Video Encoder) Enable"
    default y

#config AMP_COMPONENT_IMGDEC_ENABLE
#    bool "Imgdec Enable"
#    default n

config AMP_COMPONENT_VOUT_ENABLE
    bool "VOUT (Video Output) Enable"
    default y

config AMP_COMPONENT_DEINT_ENABLE
    bool "DEINT (Offline Video Deinterlace) Enable"
    default y

config AMP_COMPONENT_SCALER_ENABLE
    bool "SCALER (Offline Video Scaler) Enable"
    default y

config AMP_COMPONENT_SR_ENABLE
    bool "SuperRes (AI Video Scaling) Enable"
    default n
    depends on SYNAP

config AMP_COMPONENT_VA_ENABLE
    bool "Video Analytics Enable"
    default n
    depends on SYNAP

source "module/ampsdk/kconfig/Kconfig.video.vdec"
source "module/ampsdk/kconfig/Kconfig.video.dispsrv"

menu "HDR SETTINGS"

config AMP_HLG
    bool "HLG (Hybrid Log-Gamma) HDR"
    default y

config AMP_THDR
    bool "Technicolor HDR"
    default y

config AMP_DOLBY_VISION
    bool "Dolby Vision HDR"
    default y
    select AMP_COMPONENT_DVS_ENABLE

config AMP_COMPONENT_DVS_ENABLE
    depends on AMP_DOLBY_VISION
    bool
    default y

config AMP_DOLBY_DUMP
    bool
    prompt "Overlay Frame Dump" if AMP_DEVELOPMENT_OPTION
    default n

endmenu

endmenu
```
